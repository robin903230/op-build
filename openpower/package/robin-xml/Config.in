## openpower/package/robin-xml/Config.in
```kconfig
config BR2_PACKAGE_ROBIN_XML
        bool "robin_xml"
        default y if (BR2_OPENPOWER_CONFIG_NAME = "robin")
        select BR2_PACKAGE_COMMON_P8_XML
        help
            Utilites for building xml and the targeting binary image

config BR2_ROBIN_SYSTEM_XML_FILENAME
        string "Robin targeting system xml filename"
        default ""
        help
            Defines the name of the system XML filename to be used when creating targeting binary image

config BR2_ROBIN_MRW_XML_FILENAME
        string "Robin targeting mrw xml filename"
        default ""
        help
            Defines the name of the mrw XML filename to be used when creating targeting binary image

config BR2_ROBIN_BIOS_XML_FILENAME
        string "Robin BIOS metadata XML filename"
        default ""
        help
            Defines the name of the BIOS XML filename to parse when generating BIOS metadata
```
